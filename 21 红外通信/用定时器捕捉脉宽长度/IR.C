#include"IR.H"

/**********************************************************
*定时中断函数，每中断一次需要256 * 0.5us = 128 us
* 24MHz 内部晶振 1/24*12=0.5us
*
***********************************************************/
void time0() interrupt 1
{ 
  IRtime++;//128us
}

/**********************************************************
*外部中断函数，提取数据码
*
***********************************************************/
void int0() interrupt 0
{  
 
  static unsigned char i;	//静态变量用于存入33次数据计数
  static bit startflag;		//开始储存脉宽标志位
 //  LED=!LED;
  if(startflag)
  {
    if((IRtime < 53)&&(IRtime>=32)) i = 0;  //判断是否为起始码
	IRdata[i] = IRtime;	  //以T0益出的次数来计算脉宽，把这个值存入数组中
	IRtime = 0;
	i++;     //存入下一位
	if(i==33)	//i等于33表示数据传完
	{
	 	IRok = 1;	//标志位
		i=0;		//清零
	}
	
  }
  else
	{
	  IRtime =0;	//时间清零
	  startflag = 1;
	}
}

/**********************************************************
*将33次脉宽解码出来
*
***********************************************************/
void IRcordpro()
{
  unsigned char i;  // 计数处理4个字节
  unsigned char j;	//计数处理1个字节的8位数据
  unsigned char k;	//计数处理33次脉宽
  k = 1;	//从第一位开始处理，都掉起始码
  for(i= 0;i<4;i++)
  {
   for(j=0;j<8;j++)
   {
	  if(IRdata[k] >5) IRcord[i] |= 0x80;	  //data里面的存的时间大于10*128us=12.8ms,表示位1.
	  if(j < 7) IRcord[i] >>= 1;			// 只能向右移7次
	  k++;     //处理下一次脉宽
   }
  }
  IRpro_ok = 1; //解码完成标志
}


